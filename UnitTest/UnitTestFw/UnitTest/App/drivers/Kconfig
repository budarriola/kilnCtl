## firmware/KilnFW/App/drivers/Kconfig
```kconfig
menu "KilnCtrl Hardware Configuration"

    menu "I2C Bus (SX1509 I/O expander)"
        config KILNCTL_I2C_SDA_IO
            int "I2C SDA GPIO"
            default 8
            range 0 48

        config KILNCTL_I2C_SCL_IO
            int "I2C SCL GPIO"
            default 9
            range 0 48
    endmenu

    menu "SPI Bus (MAX31856 x3 + ILI9488 display)"
        choice KILNCTL_SPI_HOST_CHOICE
            prompt "SPI host peripheral"
            default KILNCTL_SPI_HOST_SPI2

        config KILNCTL_SPI_HOST_SPI2
            bool "SPI2"
        config KILNCTL_SPI_HOST_SPI3
            bool "SPI3"
        endchoice

        config KILNCTL_SPI_SCLK_IO
            int "SPI SCLK GPIO"
            default 12
            range 0 48

        config KILNCTL_SPI_MOSI_IO
            int "SPI MOSI GPIO"
            default 11
            range 0 48

        config KILNCTL_SPI_MISO_IO
            int "SPI MISO GPIO"
            default 13
            range 0 48
    endmenu

    menu "MAX31856 Thermocouple Channels (via J6)"
        config KILNCTL_THERMO_CS0_IO
            int "Channel 0 ~CS GPIO"
            default 14
            range 0 48

        config KILNCTL_THERMO_CS1_IO
            int "Channel 1 ~CS GPIO"
            default 17
            range 0 48

        config KILNCTL_THERMO_CS2_IO
            int "Channel 2 ~CS GPIO"
            default 18
            range 0 48

        config KILNCTL_THERMO_FAULT0_IO
            int "Channel 0 ~FAULT GPIO"
            default 38
            range 0 48

        config KILNCTL_THERMO_FAULT1_IO
            int "Channel 1 ~FAULT GPIO"
            default 47
            range 0 48

        config KILNCTL_THERMO_FAULT2_IO
            int "Channel 2 ~FAULT GPIO"
            default 48
            range 0 48

        config KILNCTL_THERMO_SPI_CLOCK_HZ
            int "MAX31856 SPI clock (Hz)"
            default 4000000
            range 100000 4000000
            help
                4 MHz is a CEILING, not just a default -- the range above
                will not let you raise it, and MAX31856.c repeats the limit
                as a _Static_assert in case sdkconfig is hand-edited.

                The part itself is rated to 5 MHz, so the cap is not the
                silicon. It is the SimFW bench fixture: its PIO/DMA MAX31856
                slave emulation must present the first response byte before
                the master's MISO sample point, which is one SCLK period
                minus setup -- about 250 ns at 4 MHz, tightening to about
                200 ns at 5 MHz. The implemented DMA-fed path takes about
                150-215 ns at the RP2040's stock 125 MHz sysclk. That has
                margin at 4 MHz and largely none at 5 MHz. See
                firmware/SimFW/docs/SPI_ACCESS_AUDIT.md section 9 for the
                derivation.

                Missing that deadline does not look like a fault. The whole
                burst shifts by one byte position and returns plausible
                temperatures that are wrong, which is why this is enforced
                rather than merely commented.

                This does not constrain the ILI9488, which is a separate
                device on the same bus with its own clock
                (KILNCTL_DISPLAY_SPI_CLOCK_HZ) and is unaffected by this cap.

                The signals also cross a ribbon cable to the daughterboard,
                so back this off further if reads come back corrupted.

        config KILNCTL_THERMO_DEFAULT_AUTO_CONVERT
            bool "Start channels in automatic conversion mode"
            default y
            help
                Automatic mode converts continuously (~100 ms with one
                sample averaged) and asserts ~DRDY each time. With this off
                the channels come up idle and each reading needs an explicit
                one-shot.
    endmenu

    menu "SX1509 I/O Expander (relays + digital I/O + display control)"
        config KILNCTL_SX1509_I2C_ADDR
            hex "SX1509 I2C address"
            default 0x3E
            help
                ADDR1/ADDR0 both strapped to GND on this board, giving 0x3E.
                The part also answers at 0x3F/0x70/0x71 when strapped
                differently; the running firmware can be re-targeted from the
                PC without reflashing.

        config KILNCTL_SX1509_IRQ_IO
            int "SX1509 ~INT GPIO"
            default 7
            range 0 48

        config KILNCTL_SX1509_RESET_IO
            int "SX1509 ~RESET GPIO"
            default 10
            range 0 48

        config KILNCTL_SX1509_RELAYS_OFF_ON_LINK_LOSS
            bool "Drop all relays when the PC link goes away"
            default y
            help
                A kiln element left on by a crashed or unplugged controller
                is the failure this exists to prevent. Turn it off only for
                bench work where the board is expected to run unattached.

        config KILNCTL_PC_LINK_LOSS_ASSERTS_FAULT
            bool "Assert the isolated fault line when the PC link goes away"
            default n
            help
                Whether losing the PC control link also asserts the isolated
                fault line to the safety processor, which trips it.

                Off by default, deliberately. The PC link is a debug and
                control channel for the MCP tooling, not something the kiln
                needs in order to run: this board has its own LCD and web UI
                and is expected to fire without a host attached. With this on,
                a board sitting on the bench with nothing plugged into it
                asserts the fault line five seconds after boot, trips the
                safety processor with S6a, and stays tripped -- the trip
                latches, so it survives the link coming back. That is what a
                standalone board did before this option existed, and it made
                the panel show a permanent fault for no hazard.

                Turn it on for a setup where the PC genuinely is the operator
                interface and its absence really does mean the kiln is
                unattended. The relay drop above is a separate switch and is
                still on by default either way.
    endmenu

    menu "ILI9488 Display (BIGTREETECH TFT35 SPI V2.1, J2)"
        choice KILNCTL_DISPLAY_PANEL
            prompt "Panel driven by panel_spi.c"
            default KILNCTL_DISPLAY_PANEL_ILI9488
            help
                DISPLAY_ST7796_PLAN.md Sec.6 Step 3 / Sec.12 Phase 3:
                Kconfig-only panel selection, no auto-detection yet -- that
                is Phase 4, and it is blocked on Sec.4's bench-recorded
                RDDID bytes, which do not exist. ILI9488 (the BIGTREETECH
                TFT35 actually wired to J2 today) stays the default; picking
                ST7796 selects the LCDWIKI/Elecrow MSP4031 driver, which has
                NEVER RUN ON HARDWARE -- see the STOP block at the top of
                the plan doc before that module goes anywhere near J2.
                There is deliberately no "auto" choice here: this phase
                explicitly does not implement detection, and an auto option
                that silently fell back to one fixed panel would misrepresent
                that as a real choice.

            config KILNCTL_DISPLAY_PANEL_ILI9488
                bool "ILI9488 (BIGTREETECH TFT35 SPI V2.1)"

            config KILNCTL_DISPLAY_PANEL_ST7796
                bool "ST7796 (LCDWIKI/Elecrow MSP4031) -- UNTESTED, see STOP block"
        endchoice

        config KILNCTL_DISPLAY_CS_IO
            int "Display ~CS GPIO"
            default 21
            range 0 48

        config KILNCTL_DISPLAY_SPI_CLOCK_HZ
            int "Display SPI clock (Hz)"
            default 20000000

        config KILNCTL_DISPLAY_WIDTH
            int "Display width (pixels, unrotated)"
            default 320

        config KILNCTL_DISPLAY_HEIGHT
            int "Display height (pixels, unrotated)"
            default 480

        config KILNCTL_DISPLAY_SWAP_DC_RESET
            bool "Take the schematic's LCD_IORQ/LCD_Reset naming literally"
            default n
            help
                The main board calls J2 pin 1 LCD_IORQ and pin 4 LCD_Reset,
                but every available pinout for the BIGTREETECH TFT35 SPI
                module says pin 1 is the touch controller's interrupt and
                pin 4 is RS (data/command), with no panel reset brought out.
                Off (the default) follows the module: data/command on
                expander IO15 (J2 pin 4). Turn this on to use the
                schematic's naming instead: data/command on IO14 (pin 1).
                If the panel shows nothing but its ID reads back correctly,
                this is the first thing to flip.

        config KILNCTL_DISPLAY_ROTATION
            int "Startup rotation (0-3)"
            default 1
            range 0 3
            help
                0/2 are portrait 320x480, 1/3 landscape 480x320.

        config KILNCTL_DISPLAY_DC_RESET_DIRECT_GPIO
            bool "Drive D/C and ~RESET from ESP32 GPIOs directly (bench wiring)"
            default n
            help
                Bench-wiring override for bring-up when the SX1509 expander
                isn't available or isn't trusted yet: instead of D/C and
                ~RESET going through the expander (IO14/IO15, the normal main
                board wiring -- see KILNCTL_DISPLAY_SWAP_DC_RESET), drive them
                from two bare ESP32 GPIOs, same as ~CS already is. With this
                on, the display no longer needs the expander at all -- it will
                come up even if the SX1509 is dead or unwired, unlike the
                normal (off) wiring where the expander is required just to
                send a single command. Off (the default) matches the main
                board as designed. All other display connections (SPI,
                ~CS, power) are unaffected either way.

        config KILNCTL_DISPLAY_DC_GPIO
            int "D/C GPIO (direct-wired bench mode)"
            default 0
            range 0 48
            depends on KILNCTL_DISPLAY_DC_RESET_DIRECT_GPIO

        config KILNCTL_DISPLAY_RESET_GPIO
            int "~RESET GPIO (direct-wired bench mode)"
            default 1
            range 0 48
            depends on KILNCTL_DISPLAY_DC_RESET_DIRECT_GPIO
    endmenu

    menu "NS2009 Touch Controller (on the TFT35 SPI panel, J2)"
        config KILNCTL_TOUCH_IDLE_TIMEOUT_MS
            int "Screen auto-blank timeout (ms, 0 = disabled)"
            default 0
            range 0 3600000
            help
                How long the panel goes with no touch -- real, from the
                NS2009, or synthetic, injected over the UART bridge's
                TOUCH_CMD_INJECT -- before screen_idle_task paints the frame
                solid black (ILI9488_clear). This board has no backlight
                control line, so that -- not ILI9488_set_power(false), which
                blanks to a bright WHITE page on this panel -- is the closest
                to "dark" firmware can manage; the backlight itself stays
                lit. Saving the panel's useful life is still the point. A
                touch of either kind wakes it again immediately (screen_on
                goes back to true; repainting real content is the PC/
                dashboard's job, same as any other redraw).

                Set to 0 to disable auto-blank entirely -- the screen simply
                stays on (2026-08-18: made the default per user request).
                screen_idle_task still polls the touch controller and still
                services injected touches harmlessly when disabled; it just
                never blanks. Touch activity tracking (TOUCH_CMD_GET_STATE's
                idle_ms) keeps working either way.

        config KILNCTL_TOUCH_Z1_MAX_THRESHOLD
            int "Touch pressure threshold (raw NS2009 Z1 ADC counts, 0-4095)"
            default 200
            range 0 4095
            help
                NS2009_read treats a Z1 reading above this as "pressed".
                The NS2009 datasheet's typical application (and this
                driver's original assumption) has a touch drive Z1 *low*,
                with an untouched panel floating near full scale -- that
                does NOT hold on this board revision. Bench testing
                2026-08-19 (device log, NS2009's raw_x/raw_y/z1 diagnostic)
                found the opposite: Z1 floats at 0-30 with nothing touching
                the panel, and a real firm press drove it to 1047 -- either
                a wiring difference (see the SDA/SCL-swap question in
                docs/HARDWARE.md) or this panel's Z1 behaves differently in
                the "short driver, auto power-down" mode this driver uses.
                The 200 default sits well above the observed idle-noise
                ceiling (30) and well below the one observed real press
                (1047), with margin on both sides since only one bench
                sample of a real press exists so far. If touches are missed
                or the panel reports phantom presses with nothing touching
                it, this is the first thing to tune, the same way
                KILNCTL_DISPLAY_SWAP_DC_RESET is the first thing to flip for
                a blank panel.
    endmenu

    menu "LVGL Touchscreen UI (TODO.md section 10)"
        config KILNCTL_LVGL_BUF_ROWS
            int "LVGL draw buffer height (panel rows)"
            default 40
            range 4 480
            help
                Each of LVGL's two draw buffers is this many rows tall (at
                the panel's current rotated width) x 2 bytes/pixel (RGB565),
                allocated in PSRAM (see TODO.md 9.1a's 2026-08-17 reversal).
                Smaller means more, smaller flush calls (finer partial
                redraws, more SPI transaction overhead); larger means fewer,
                bigger flushes. 40 rows at 480px wide is 2 x 38.4 KB -- a
                rounding error against 8 MB of PSRAM, so raise this freely if
                flush overhead ever shows up as sluggish.

        config KILNCTL_TOUCH_CAL_SWAP_XY
            bool "Touch: swap raw X/Y axes before mapping to pixels"
            default n
            help
                Resistive touch panels have no fixed relationship between
                their raw X/Y axes and the panel's rotated pixel axes -- it
                depends on how the film is oriented under the glass, which is
                not documented for this module. Like
                KILNCTL_DISPLAY_SWAP_DC_RESET and KILNCTL_TOUCH_Z1_MAX_THRESHOLD,
                this is a bench-calibration knob, not a datasheet value: if
                touches land rotated 90 degrees from where they should,
                this is the first thing to flip.

        config KILNCTL_TOUCH_CAL_INVERT_X
            bool "Touch: invert raw X axis"
            default n

        config KILNCTL_TOUCH_CAL_INVERT_Y
            bool "Touch: invert raw Y axis"
            default n
    endmenu

    menu "Safety Processor Link (opto-isolated UART to the RP2040)"
        config KILNCTL_SAFETY_TX_IO
            int "Safety UART TX GPIO"
            default 5
            range 0 48
            help
                Drives U2's optocoupler LED through R12 (390R) via net
                DataToSafty, whose collector is the Pico's RX (GP5, PicoRx).

        config KILNCTL_SAFETY_RX_IO
            int "Safety UART RX GPIO"
            default 4
            range 0 48
            help
                U3's collector, net DataFromSafty (the Pico's TX, GP4,
                drives U3's LED through R7). R15 (1k to 3.3V_Main) is fitted
                externally on this net; the internal pull-up is belt-and-braces.

        config KILNCTL_SAFETY_FAULT_IO
            int "Isolated fault line GPIO (output)"
            default 6
            range 0 48
            help
                Output, not input: driving it high lights U1's LED and pulls
                the safety processor's mainFault input low.

        config KILNCTL_SAFETY_BAUD_RATE
            int "Safety link baud rate"
            default 230400
            help
                Must stay equal to SaftyFW's UART_OWNER_BAUD_RATE
                (src/tasks/uart_owner.c) AND to the bootloader's recovery-mode
                uart_init (bootloader/main.c) -- all three hardcode it, there
                is no negotiation. A mismatch does not degrade, it produces
                framing errors and nothing else.

                HISTORY, because the old number here was widely quoted and is
                now wrong. Until 2026-08-25 this was 9600, and that ceiling
                was a property of the TCMT1109 optocouplers, not of either
                firmware. Measured 2026-08-23 across the opto pair:

                  115200 -- zero frames received, ever
                   57600 -- zero frames received, ever
                   38400 -- about 80% received (53 of 66), errors climbing
                   19200 -- clean over a short window, but over a longer one
                            received lagged sent (107 of 118, then 117 of
                            134): about 10% of frames still lost
                    9600 -- received tracks sent one for one over minutes

                Those optocouplers were replaced on 2026-08-25 by a single
                ADuM1201WT digital isolator (U6, hardware/mainBoard/
                SaftyProcessor.kicad_sch), which is non-inverting, has one
                unidirectional channel per direction, and is rated far past
                anything this UART needs. The inversions both firmwares used
                to apply to cancel the optos' own inversion were removed in
                the same change -- see safety_link.c's comment at
                uart_owner_init, and uart_owner.c's at uart_owner_init.

                MEASURED SWEEP RESULTS, against U6, 60 seconds continuous per
                rate, both sides rebuilt and reflashed for each rate. A rate
                passes only if NONE of these four counters gain a single count
                during the window -- crc/framing errors, length mismatch, crc
                mismatch, resync -- AND status replies keep answering the
                500 ms poll. `timeouts` and `config_page` are deliberately
                excluded from the verdict: both are dominated by the separate
                open safety_cfg_store_refetch defect (page 0 failed /
                ESP_ERR_TIMEOUT), which climbs identically at every baud rate
                and would fail all of them for a reason that has nothing to
                do with baud.

                  921600 -- PASS. 0 new crc/framing, 0 length mismatch,
                            0 crc mismatch, 0 resync. Status +124 in 62 s
                            (2.00/s).
                  460800 -- PASS. 0 new crc/framing, 0 length mismatch,
                            0 crc mismatch, 0 resync. Status +123 in 62 s
                            (2.00/s).
                  230400 -- PASS. 0 new crc/framing, 0 length mismatch,
                            0 crc mismatch, 0 resync. Status +124 in 62 s
                            (2.01/s).

                Negative control, proving the test can fail: ESP at 230400
                against a Pico deliberately left at 115200 failed in 3 s,
                crc/framing errors rising 941 -> 1062 (+121) and length
                mismatch 58 -> 69.

                CHOSEN VALUE: 230400, i.e. this default. Rule used: the
                fastest passing rate was 921600; one standard step down from
                that is 460800; the chosen value is the slower of that step
                and the requested 230400 -- so 230400, two full standard
                steps below a rate that soaks clean.

                Two methodology traps this sweep ran into, worth remembering
                if it is ever re-run:

                1. `sent` and `received` (from GET_LINK_STATS) are NOT a loss
                   metric and must never be compared to each other. `sent`
                   counts outbound requests of several kinds; `received`
                   counts status replies only, and equals the histogram's
                   `status` count exactly. Comparing them shows ~50% "loss"
                   at every rate, including a deliberately mismatched pair --
                   that is the metric being wrong, not the link.
                2. Flashing resets the Pico while the ESP keeps running, and
                   that reset throws a genuine burst of framing errors (plus
                   `break condition on uart1` / `frame length mismatch` log
                   lines). The measurement window must start after a settle
                   delay following any flash, or every rate fails on reset
                   residue rather than its own behavior -- an earlier sweep
                   attempt misread exactly this residue as a 921600 failure;
                   921600 in fact passes cleanly once measured past the
                   reset.

                Do not raise this above 921600 (the fastest rate measured to
                pass) without re-running the sweep.

                Still true, and still the trap that hid the opto ceiling for
                weeks: static GPIO high/low tests pass at ANY baud rate,
                because both an optocoupler and a digital isolator carry a DC
                level perfectly. A verified-by-GPIO-test wire proves nothing
                about the rate it can carry.

        config KILNCTL_SAFETY_POLL_PERIOD_MS
            int "Safety processor poll period (ms)"
            default 500
            range 0 60000
            help
                How often the firmware asks the safety processor for its
                status. 0 disables polling entirely (the link then only
                carries explicit PING/REQUEST_ENABLE traffic).
    endmenu

    menu "UART Link (PC control interface)"
        choice KILNCTL_UART_PORT_CHOICE
            prompt "UART port"
            default KILNCTL_UART_PORT_0
            help
                Which hardware UART peripheral to use for the PC link.
                UART1 is taken by the safety processor link, so this should
                stay on UART0 unless that link is disabled.

        config KILNCTL_UART_PORT_0
            bool "UART0"
        config KILNCTL_UART_PORT_1
            bool "UART1"
        endchoice

        config KILNCTL_UART_TX_IO
            int "UART TX GPIO"
            default 43
            range 0 48
            help
                GPIO43/44 are the dev board's own UART0 pins, routed through
                its USB-UART bridge and its dedicated USB-C port -- distinct
                from the native USB / USB-Serial-JTAG port (GPIO19/20) used
                for flashing and debugging. The main board leaves both
                unconnected.

        config KILNCTL_UART_RX_IO
            int "UART RX GPIO"
            default 44
            range 0 48

        config KILNCTL_UART_BAUD_RATE
            int "UART baud rate"
            default 921600
            help
                PC link only (UART_OWNER_PORT_NUM), not the isolated safety
                link (KILNCTL_SAFETY_BAUD_RATE, separate UART, unchanged).
                Bumped from 115200 -- the CH343 USB-UART bridge on this board
                is rated well past this, and every frame is still CRC'd and
                retried (protocol.py's Frame/UartLink), so a bad byte at the
                higher rate is a retry, not silent corruption. The dominant
                cost in a DISPLAY blit is still the per-frame stop-and-wait
                ACK round trip (UART_PROTO_MAX_PAYLOAD=128 B/frame, one ACK
                each), so this helps but does not fix that; pipelining
                multiple in-flight frames would need a wire-protocol change,
                not a config one. Must match pc_tools's DEFAULT_BAUD_RATE
                (protocol.py) -- both sides hardcode the same value rather
                than negotiating it.

        config KILNCTL_UART_OWNER_QUEUE_LEN
            int "uart_owner request queue length"
            default 8
            help
                How many in-flight uart_owner_transfer() requests (from any
                caller sharing this owner) can be queued before a caller
                blocks.

        config KILNCTL_UART_OWNER_TASK_PRIORITY
            int "uart_owner task priority"
            default 5

        config KILNCTL_UART_OWNER_STACK_SIZE
            int "uart_owner task stack size (bytes)"
            # 4096 -> 3072 (2026-08-27), on measurement rather than by feel.
            # This one number sizes FOUR tasks: main.c's PC-link uart_owner
            # pair and safety_link.c's safety-link pair. All four are now
            # registered for high-water reporting (they were not before -- the
            # safety pair, the one carrying the telemetry that gates heating,
            # was measured by nobody), and after a firing that ran to
            # completion with rules active the worst of the four had used 904
            # bytes. 3072 leaves 2168 free above that, ~70% headroom.
            #
            # Not cut closer on purpose: a Pico OTA relay transfer streams
            # through the safety-link pair and has never been measured, so the
            # margin has to cover a path the numbers do not yet include. Re-read
            # the high-water marks after a real Pico update before going lower.
            default 3072

        config KILNCTL_UART_PROTOCOL_TASK_PRIORITY
            int "uart_protocol RX task priority"
            default 6

        config KILNCTL_UART_PROTOCOL_STACK_SIZE
            int "uart_protocol RX task stack size (bytes)"
            default 8192
            help
                Raised 6144 -> 8192 on 2026-08-28, second move the same
                day: chunk[] grew again, STUFFED_FRAME_MAX (528) ->
                UART_PROTOCOL_RX_CHUNK_BYTES (2048), at the owner's
                request. That is +1520 bytes of stack, and the whole point
                of the 6144 note below is that the stack must move WITH the
                locals rather than after the crash. 8192 restores roughly
                the ~3 kB free the 6144 bump bought.

                Raised 4096 -> 6144 on 2026-08-28. uart_protocol_rx_task's
                chunk[] buffer grew from 32 bytes to STUFFED_FRAME_MAX
                (~530) to fix a live commissioning defect -- page 1 of a
                CONFIG_PAGE fetch timed out on every attempt because
                assembling it took 5-8 scheduler round trips. That buffer
                plus raw[] (~265) lives on this task's stack, and the stack
                did not move with them: stack_margin then measured
                safety_proto_rx at 1024 B free of 4096 (25%, LOW) -- the
                thinnest margin on the board.

                This is the same shape as the safety_poll crash the same
                day: locals grew, the stack did not, and nothing was
                watching until the task died with IllegalInstruction. Fixed
                before the crash rather than after it.

                NOTE this default is only what a FRESH clone gets --
                sdkconfig is gitignored and wins over it (see the build's
                own "Kconfig defaults policy: use sdkconfig" note), so an
                existing checkout needs its sdkconfig updated too.
    endmenu

    menu "Wi-Fi Provisioning"
        config KILNCTL_WIFI_AP_SSID
            string "Fallback AP SSID"
            default "kilnCtl"
            help
                SSID the board advertises whenever it has no working station
                connection -- no credentials saved, saved credentials that
                fail to join, or AP mode is selected (AP mode still uses
                this AP, permanently instead of as a fallback). Overridden
                at runtime, without a rebuild, by wifi_prov_set_ap_ssid()
                (the GUI's Access Point mode "Save" control) once that has
                been called at least once.

        config KILNCTL_WIFI_AP_DEFAULT_PASSWORD
            string "Fallback AP password"
            default "password"
            help
                Compile-time default so a fresh board is usable without an
                existing network. WPA2-PSK requires 8-63 characters. Change
                this before fielding a board outside a bench/lab setting.
                Overridden at runtime, without a rebuild, by
                wifi_prov_set_ap_password() (the GUI's "Set AP Password"
                control) once that has been called at least once.

        config KILNCTL_WIFI_AP_CHANNEL
            int "Fallback AP channel"
            default 6
            range 1 13

        config KILNCTL_WIFI_STA_CONNECT_TIMEOUT_MS
            int "Station join timeout (ms)"
            default 15000
            help
                How long to wait for a station join (association + DHCP)
                before giving up and falling back to (or staying on) the AP.
    endmenu

    config KILNCTL_LOG_TEE_CONSOLE
        bool "Also print log lines to the console UART"
        default y
        help
            uart_log_bridge replaces console logging with a push to the PC
            link. That queue drops lines when full, which it reliably is
            during the boot burst -- so the board's own account of a failed
            bring-up is exactly what gets lost. With this on, every line also
            goes to the console UART (GPIO43/44), where nothing can drop it.

            Costs a blocking console write per log line. Turn it off if a
            logging-heavy path ever needs the microseconds back.

    menu "Simulated plant (development only)"

        config KILNCTL_SIM_PLANT
            bool "Run the control stack against a simulated kiln"
            default n
            help
                Feeds the profile executor, autotune engine, and dashboard
                from App/test/sim_plant.c's thermal model instead of the
                MAX31856 thermocouples, and lets faults (dead element,
                welded relay, detached/frozen/open thermocouple) be injected
                over POST /api/sim. This is how the thermal guards get
                exercised end to end without a kiln -- and without the
                thermocouple daughterboard or relay expander, neither of
                which is attached to the bench unit.

                LEAVE THIS OFF FOR ANYTHING THAT WILL BE NEAR A REAL KILN.
                With it on the board reports fabricated temperatures and
                will happily claim a healthy firing with nothing plugged in.
                Relay writes still go out to the real expander if one is
                present, so a sim build must not be flashed to a board wired
                to elements.

        config KILNCTL_SIM_AMBIENT_C
            int "Simulated ambient temperature (degC)"
            depends on KILNCTL_SIM_PLANT
            default 20

        config KILNCTL_SIM_THERMAL_MASS_J_PER_C
            int "Simulated zone thermal mass (J per degC)"
            depends on KILNCTL_SIM_PLANT
            default 50000
            help
                With the default loss coefficient this sets the zone's time
                constant tau = mass/loss = 10000s, which is kiln-like.

        config KILNCTL_SIM_HEATER_POWER_W
            int "Simulated element power per zone (W, at duty 1.0)"
            depends on KILNCTL_SIM_PLANT
            default 2000

        config KILNCTL_SIM_LOSS_W_PER_C
            int "Simulated linear heat loss (W per degC above ambient)"
            depends on KILNCTL_SIM_PLANT
            default 5
            help
                Sets the duty-1.0 ceiling: ambient + power/loss (420 degC
                with the defaults here). Raise the power or lower this to
                simulate a kiln that can reach cone temperature.

        config KILNCTL_SIM_RADIATIVE_COEFF_E12
            int "Simulated radiative loss coefficient (units of 1e-12 W per K^4)"
            depends on KILNCTL_SIM_PLANT
            default 2000
            help
                Adds a Stefan-Boltzmann loss term on top of the linear one,
                so plant gain falls with temperature the way a real kiln's
                does. 0 disables it (purely linear plant). Expressed in
                1e-12 units because Kconfig has no float type; the default
                2000 means 2e-9 W/K^4.

        config KILNCTL_SIM_COUPLING_W_PER_C
            int "Simulated inter-zone conductance (W per degC)"
            depends on KILNCTL_SIM_PLANT
            default 3
            help
                How strongly each zone heats its neighbors. 0 makes the
                zones independent, which is the one thing a real
                multi-zone kiln is not.

        config KILNCTL_SIM_SENSOR_DELAY_S
            int "Simulated sensor transport delay (s)"
            depends on KILNCTL_SIM_PLANT
            default 5

        config KILNCTL_SIM_SENSOR_LAG_S
            int "Simulated thermocouple lag time constant (s)"
            depends on KILNCTL_SIM_PLANT
            default 8

        config KILNCTL_SIM_SENSOR_NOISE_MC
            int "Simulated sensor noise, peak-to-peak (milli-degC)"
            depends on KILNCTL_SIM_PLANT
            default 0
            help
                0 for a clean reading. 1000 (i.e. 1 degC) is a reasonable
                value for checking that the guards do not false-trip on
                noise alone.

    endmenu

    config KILNCTL_HEARTBEAT_LED_GPIO
        int "Heartbeat LED GPIO (-1 to disable)"
        default -1
        range -1 48
        help
            The main board has no MCU-driven LED -- D25/D28 are rail
            indicators tied straight to 3.3V/5V -- and the dev board's
            addressable RGB LED is removed on this build. Left at -1 the
            monitor task still runs and still reports over the log link; it
            just doesn't blink anything.

    config KILNCTL_ENABLE_GPIO_PROBE
        bool "Enable raw GPIO probe over UART (debug only)"
        default n
        help
            Adds UART_TASK_ID_GPIO_PROBE: set-mode/write/read on ESP32-S3
            pins from the PC, gated by a hard deny-list (SPI, I2C, the
            SX1509 IRQ/RESET pins, the display CS, the PC-link UART pins,
            and every safety-link pin including GPIO6/SAFETY_FAULT_IO) and
            refused outright while a profile is running. Exists to answer
            "is this net where the schematic says" without a one-off
            firmware -- tools/PcTools/TODO.md capability 1.

            Leave this OFF for any build going near a real heater. It is a
            bench/bring-up tool, not a production capability: a debug tool
            that can twiddle arbitrary pins on a board that drives mains
            relays is exactly the hazard docs/SAFETY_MODEL.md exists to
            avoid, and the deny-list is enforced in this firmware, not by
            whoever is holding the PC end.

endmenu
```
