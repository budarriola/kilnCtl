## firmware/KilnFW/components/tls_spike/Kconfig
```kconfig
menu "TLS network spike (GitHub release fetch, WP7)"

    config KILNCTL_TLS_SPIKE
        bool "Build the one-shot GitHub HTTPS fetch spike (measurement only)"
        default n
        help
            docs/GITHUB_RELEASE_UPDATE_PLAN.md M2 WP7. When y, a self-starting task
            waits for a STA IP and valid wall time, then performs ONE HTTPS GET
            chain (api.github.com, then any redirect) and logs internal-heap
            numbers under the log tag TLS_SPIKE. It writes no flash and takes no
            route. Default n: the component compiles to nothing.

    config KILNCTL_TLS_SPIKE_URL
        string "First URL"
        depends on KILNCTL_TLS_SPIKE
        default "https://api.github.com/repos/budarriola/kilnCtl/releases/latest"
        help
            Set this to a /releases/assets/<id> URL (Accept octet-stream is sent
            for it) or a github.com/.../releases/download/... URL to exercise the
            302 to release-assets.githubusercontent.com.

    config KILNCTL_TLS_SPIKE_DELAY_S
        int "Seconds to wait after IP + time sync before fetching"
        depends on KILNCTL_TLS_SPIKE
        default 90
        range 10 600

    config KILNCTL_TLS_SPIKE_MAX_BYTES
        int "Stop reading the body after this many bytes"
        depends on KILNCTL_TLS_SPIKE
        default 524288
        range 4096 16777216

    config KILNCTL_TLS_SPIKE_REPEAT
        int "Number of full fetch chains (1 = single shot)"
        depends on KILNCTL_TLS_SPIKE
        default 1
        range 1 10

endmenu
```

## firmware/KilnFW_recovery/main/Kconfig.projbuild
```kconfig
menu "KilnCtrl Recovery"

    config KILNCTL_STAGE_CHIP_REV_CHECK
        bool "Check the image chip revision range when verifying a staged OTA image"
        default y
        help
            Build-time owner opt-out for RY-01. On: stage verify refuses an image whose
            header min/max chip revision excludes this chip (IDF
            bootloader_common_check_chip_validity) before anything is erased. Off: such an
            image passes the stage verify. In the recovery image the app partition is then
            erased and only the post-copy esp_image_verify refuses it, leaving the board
            in recovery with no app. Keep on unless you deliberately flash images built
            for a different chip revision. Not a runtime or web setting. The recovery
            image defines the same symbol (KilnFW_recovery/main/Kconfig.projbuild).

endmenu
```
